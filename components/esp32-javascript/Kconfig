## components/esp32-javascript/Kconfig
```kconfig
menu "ESP32 JavaScript"

config ESP32_JS_BASIC_AUTH_USERNAME
    string "Basic auth username"
    default "esp32"

config ESP32_JS_BASIC_AUTH_PASSWORD
    string "Basic auth password"
    default "esp32"

endmenu
```
